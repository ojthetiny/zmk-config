## boards/arm/bella/Kconfig
```kconfig
# SPDX-License-Identifier: MIT

config BOARD_ENABLE_DCDC
    bool "Enable DCDC mode"
    select SOC_DCDC_NRF52X
    default y
    depends on BOARD_BELLA

config BOARD_BELLA_LEFT
    bool

config BOARD_BELLA_RIGHT 
    bool
```

## boards/arm/bella/Kconfig.board
```kconfig
# Copyright (c) 2023 The ZMK Contributors
# SPDX-License-Identifier: MIT

config BOARD_BELLA_LEFT
    bool "bella left"
    depends on SOC_NRF52840_QIAA

config BOARD_BELLA_RIGHT
    bool "bella right"
    depends on SOC_NRF52840_QIAA
```

## boards/arm/bella/Kconfig.defconfig
```kconfig
# Copyright (c) 2022 The ZMK Contributors
# SPDX-License-Identifier: MIT

if BOARD_BELLA_LEFT

config ZMK_KEYBOARD_NAME
    default "bella"
    
config ZMK_SPLIT_ROLE_CENTRAL
    default y

endif # BOARD_BELLA_LEFT

if BOARD_BELLA_LEFT || BOARD_BELLA_RIGHT

config BOARD
    default "bella"

config ZMK_SPLIT
    default y

endif

config BT_CTLR
	default BT

config ZMK_BLE
	default y

config ZMK_USB
	default y

endif
```

## boards/arm/lgbtkl/Kconfig.board
```kconfig
# LGBTKL board configuration

# Copyright (c) 2020 The ZMK Contributors
# SPDX-License-Identifier: MIT

config BOARD_LGBTKL
    bool "LGBTKL"
    depends on SOC_STM32F072XB
```

## boards/arm/lgbtkl/Kconfig.defconfig
```kconfig
# LGBTKL board configuration

# Copyright (c) 2020 The ZMK Contributors
# SPDX-License-Identifier: MIT

if BOARD_LGBTKL

config BOARD
    default "lgbtkl"

config ZMK_KEYBOARD_NAME
    default "LGBTKL"

config ZMK_USB
    default y

config ZMK_KSCAN_MATRIX_POLLING
    default y

endif # BOARD_LGBTKL
```

## boards/arm/nameless_ergo/Kconfig.board
```kconfig
# Copyright (c) 2023 The ZMK Contributors
# SPDX-License-Identifier: MIT

config BOARD_NAMELESS_ERGO
    bool "Nameless Ergo"
    depends on SOC_NRF52840_QIAA
```

## boards/arm/nameless_ergo/Kconfig.defconfig
```kconfig
# Copyright (c) 2023 The ZMK Contributors
# SPDX-License-Identifier: MIT

if BOARD_NAMELESS_ERGO

config ZMK_KEYBOARD_NAME
    default "nameless ergo"

if USB

config USB_NRFX
    default y

config USB_DEVICE_STACK
    default y

endif # USB

config BT_CTLR
    default BT

config I2C
    default y

config MAX17048
    default y

endif # BOARD_NAMELESS_ERGO
```

## boards/arm/uwu30/Kconfig.defconfig
```kconfig
# Copyright (c) 2023 The ZMK Contributors
# SPDX-License-Identifier: MIT

if BOARD_UWU30

config ZMK_KEYBOARD_NAME
    default "uwu30"

config BT_CTLR
    default BT

endif # BOARD_UWU30
```
