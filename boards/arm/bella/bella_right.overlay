/*
 * Copyright (c) 2022 The ZMK Contributors
 *
 * SPDX-License-Identifier: MIT
 */

#include "bella.dts"

&kscan0 {
    row-gpios
        = <&gpio0 27 (GPIO_ACTIVE_HIGH | GPIO_PULL_DOWN)>
        , <&gpio0 26 (GPIO_ACTIVE_HIGH | GPIO_PULL_DOWN)>
        , <&gpio1 09 (GPIO_ACTIVE_HIGH | GPIO_PULL_DOWN)>
        , <&gpio0 04 (GPIO_ACTIVE_HIGH | GPIO_PULL_DOWN)>
        , <&gpio0 06 (GPIO_ACTIVE_HIGH | GPIO_PULL_DOWN)>
        ;
    col-gpios
        = <&pgio1 08 GPIO_ACTIVE_HIGH>
        , <&gpio0 11 GPIO_ACTIVE_HIGH>
        , <&gpio0 13 GPIO_ACTIVE_HIGH>
        , <&gpio0 12 GPIO_ACTIVE_HIGH>
        , <&gpio0 10 GPIO_ACTIVE_HIGH>
        , <&gpio0 09 GPIO_ACTIVE_HIGH>
        , <&gpio0 08 GPIO_ACTIVE_HIGH>
        ;
};